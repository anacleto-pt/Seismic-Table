#include <AccelStepper.h>

// Pinos do Driver
const int stepPin = 2;
const int dirPin = 4;

// O teu array de passos (apenas os valores da tua tabela)
// Exemplo com os primeiros valores que enviaste:
const int sismoData[] = {
  0, 143, 148, 153, 158, 163, 170, 175, 179, 185, 194, 203,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 18 
};

const int totalPontos = sizeof(sismoData) / sizeof(sismoData[0]);
int indiceAtual = 0;
bool sismoLigado = false;
unsigned long ultimoUpdate = 0;
unsigned long tempoInicioSismo = 0; // Para marcar o "tempo zero"

AccelStepper stepper(1, stepPin, dirPin);

void setup() {
  Serial.begin(115200); 
  stepper.setMaxSpeed(50000); // Teto alto para não limitar o software
  
  Serial.println("DEBUG: TEMPO (s) | VELOCIDADE (steps/s)");
  Serial.println("Envia uma tecla para disparar o sismo...");
}

void loop() {
  // Gatilho inicial
  if (!sismoLigado && Serial.available() > 0) {
    while(Serial.available() > 0) Serial.read();
    
    indiceAtual = 0;
    sismoLigado = true;
    tempoInicioSismo = millis(); // Define o t=0
    ultimoUpdate = millis();
    
    Serial.println("Tempo_s,Velocidade_steps_s"); // Cabeçalho para o Plotter/Excel
  }

  if (sismoLigado) {
    if (millis() - ultimoUpdate >= 20) {
      ultimoUpdate = millis();

      if (indiceAtual < totalPontos) {
        float tempoAtual = (millis() - tempoInicioSismo) / 1000.0; // Converte ms para segundos
        float velocidadePonto = (float)sismoData[indiceAtual] / 0.02;
        
        stepper.setSpeed(velocidadePonto);
        
        // IMPRESSÃO DOS DADOS
        Serial.print(tempoAtual, 3); // Tempo com 3 casas decimais
        Serial.print(",");
        Serial.println(velocidadePonto); 

        indiceAtual++;
      } 
      else {
        sismoLigado = false;
        stepper.setSpeed(0);
        Serial.println("--- FIM DO SISMO ---");
      }
    }
    stepper.runSpeed();
  }
}